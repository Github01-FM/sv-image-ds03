## sv-ds03-system/conf/bblayers.conf
```bitbake
# LAYER_CONF_VERSION is increased each time build/conf/bblayers.conf
# changes incompatibly
LCONF_VERSION = "6"

BBPATH = "${TOPDIR}"
BBFILES ?= ""

BBLAYERS ?= " \
  /home/ubuntu/work/saic_ap31/RN2_SAIC_AP31_Radio/sv-ds03-system/meta \
  /home/ubuntu/work/saic_ap31/RN2_SAIC_AP31_Radio/sv-ds03-system/meta-yocto \
  /home/ubuntu/work/saic_ap31/RN2_SAIC_AP31_Radio/sv-ds03-system/meta-yocto-bsp \
  "
BBLAYERS_NON_REMOVABLE ?= " \
  /home/ubuntu/work/saic_ap31/RN2_SAIC_AP31_Radio/sv-ds03-system/meta \
  /home/ubuntu/work/saic_ap31/RN2_SAIC_AP31_Radio/sv-ds03-system/meta-yocto \
  "
```

## sv-ds03-system/meta-csr-bsp-prop/conf/layer.conf
```bitbake
# We have a conf and classes directory, add to BBPATH
BBPATH .= ":${LAYERDIR}"

# We have a recipes-* directories, add to BBFILES
BBFILES += "${LAYERDIR}/recipes-*/*/*.bb \
	${LAYERDIR}/recipes-*/*/*.bbappend"

BBFILE_COLLECTIONS += "csr-bsp-prop"
BBFILE_PATTERN_csr-bsp-prop = "^${LAYERDIR}/"
BBFILE_PRIORITY_csr-bsp-prop = "10"

#PREFERRED_PROVIDER_virtual/egl = "sgx-linux-um"
#PREFERRED_PROVIDER_virtual/libgl = "sgx-linux-um"
#PREFERRED_PROVIDER_virtual/libgles1 = "sgx-linux-um"
#PREFERRED_PROVIDER_virtual/libgles2 = "sgx-linux-um"
```

## sv-ds03-system/meta-csr-bsp/conf/bblayers.conf.sample
```bitbake
# LAYER_CONF_VERSION is increased each time build/conf/bblayers.conf
# changes incompatibly
LCONF_VERSION = "6"

BBPATH = "${TOPDIR}"
BBFILES ?= ""

BBLAYERS ?= " \
  ##OEROOT##/meta \
  ##OEROOT##/meta-yocto \
  ##OEROOT##/meta-sv \
  ##OEROOT##/meta-csr-bsp  \
  ##OEROOT##/meta-csr-bsp-prop  \
  ##OEROOT##/meta-qt5  \
  ##OEROOT##/meta-openembedded/meta-oe \
  ##OEROOT##/meta-linaro/meta-linaro-toolchain \
  "
BBLAYERS_NON_REMOVABLE ?= " \
  ##OEROOT##/meta \
  ##OEROOT##/meta-yocto \
  "
```

## sv-ds03-system/meta-csr-bsp/conf/distro/include/security_flags_qpsi.inc
```bitbake
SECURITY_CFLAGS_pn-bash = "${SECURITY_NO_PIE_CFLAGS}"
SECURITY_LDFLAGS_pn-synergy = ""
SECURITY_CFLAGS_pn-synergy = ""
```

## sv-ds03-system/meta-csr-bsp/conf/distro/include/toolchain-linaro.inc
```bitbake
GCCVERSION ?= "linaro-4.9%"
BINUVERSION ?= "linaro-2.24%"
GLIBCVERSION ?= "2.20%"
GLIBCINITVERSION ?= "2.20%"
LINUXLIBCVERSION ?= "4.1"

PREFERRED_VERSION_gcc ?= "${GCCVERSION}"
PREFERRED_VERSION_binutils ?= "${BINUVERSION}"
PREFERRED_VERSION_linux-libc-headers ?= "${LINUXLIBCVERSION}"
PREFERRED_VERSION_glibc ?= "${GLIBCVERSION}"
PREFERRED_VERSION_glibc-locale ?= "${GLIBCVERSION}"
PREFERRED_VERSION_glibc-initial ?= "${GLIBCINITVERSION}"

# Select external binary prebuilt Linaro toolchain
TCMODE = "external-linaro"
TCLIBC = "external-linaro-toolchain"

ELT_TARGET_SYS = "arm-linux-gnueabihf"
TARGET_VENDOR = ""

PREFERRED_PROVIDER_virtual/${TARGET_PREFIX}gcc-intermediate = "external-linaro-toolchain"

# Set some vars to help locate the toolchain automatically from PATH
TOOLCHAIN_SYS := "${ELT_TARGET_SYS}"
TOOLCHAIN_PREFIX := "${TOOLCHAIN_SYS}-"

# Use specific libc headers instead of ones provided by toolchain
PREFERRED_PROVIDER_linux-libc-headers-dev_forcevariable = "linux-libc-headers"
PREFERRED_PROVIDER_virtual/linux-libc-headers_forcevariable = "linux-libc-headers"

PREFERRED_PROVIDER_gcc-cross-canadian-${TRANSLATED_TARGET_ARCH} ?= "external-linaro-sdk-toolchain"
PREFERRED_PROVIDER_binutils-cross-canadian-${TRANSLATED_TARGET_ARCH} ?= "external-linaro-sdk-toolchain"
#PREFERRED_PROVIDER_gdb-cross-canadian-${TRANSLATED_TARGET_ARCH} = "external-linaro-sdk-toolchain"

# Special case for gdb to be built as part of canadian-cross-sdk, instead of packaged from external toolchain
bindir_pn-gdb-cross-canadian-${TRANSLATED_TARGET_ARCH} = "${exec_prefix}/bin"
PREFERRED_PROVIDER_gdb-cross-canadian-${TRANSLATED_TARGET_ARCH} = "gdb-cross-canadian-${TRANSLATED_TARGET_ARCH}"

# Set up runtime preferences
PREFERRED_PROVIDER_libgcc = "external-linaro-toolchain"
PREFERRED_PROVIDER_gcc-runtime = "external-linaro-toolchain"

SDKGCCVERSION ?= "linaro-4.9%"
SDKBINUVERSION ?= "linaro-2.24%"
SDKGLIBCVERSION ?= "linaro-2.20%"
SDKLINUXLIBCVERSION ?= "4.1%"

PREFERRED_VERSION_gcc-crosssdk ?= "${SDKGCCVERSION}"
PREFERRED_VERSION_gcc-crosssdk-initial ?= "${SDKGCCVERSION}"
PREFERRED_VERSION_gcc-crosssdk-intermediate ?= "${SDKGCCVERSION}"
PREFERRED_VERSION_nativesdk-gcc-runtime ?= "${SDKGCCVERSION}"
PREFERRED_VERSION_nativesdk-libgcc ?= "${SDKGCCVERSION}"
PREFERRED_VERSION_binutils-crosssdk ?= "${SDKBINUVERSION}"
PREFERRED_VERSION_nativesdk-linux-libc-headers ?= "${SDKLINUXLIBCVERSION}"
PREFERRED_VERSION_nativesdk-glibc ?= "${SDKGLIBCVERSION}"
PREFERRED_VERSION_nativesdk-glibc-initial ?= "${SDKGLIBCVERSION}"
```

## sv-ds03-system/meta-csr-bsp/conf/layer.conf
```bitbake
# We have a conf and classes directory, add to BBPATH
BBPATH .= ":${LAYERDIR}"

# We have a recipes-* directories, add to BBFILES
BBFILES += "${LAYERDIR}/recipes-*/*/*.bb \
	${LAYERDIR}/recipes-*/*/*.bbappend"

BBFILE_COLLECTIONS += "atlas-arm"
BBFILE_PATTERN_atlas-arm = "^${LAYERDIR}/"
BBFILE_PRIORITY_atlas-arm = "8"
```

## sv-ds03-system/meta-csr-bsp/conf/machine/atlas7-arm.conf
```bitbake
#@TYPE: Machine
#@NAME: atlas-arm
#@DESCRIPTION: Machine configuration for atlas-arm systems

require conf/distro/include/toolchain-linaro.inc
require conf/machine/include/atlas7.inc
require conf/distro/include/security_flags.inc
require conf/distro/include/security_flags_qpsi.inc

PREFERRED_PROVIDER_virtual/egl = "sgx-linux-um"
PREFERRED_PROVIDER_virtual/libgl = "sgx-linux-um"
PREFERRED_PROVIDER_virtual/libgles1 = "sgx-linux-um"
PREFERRED_PROVIDER_virtual/libgles2 = "sgx-linux-um"
PACKAGECONFIG_GL = "gles2"

PREFERRED_PROVIDER_virtual/xserver ?= "xserver-xorg"
XSERVER ?= "xserver-xorg \
           xf86-input-evdev \
           xf86-input-mouse \
           xf86-video-omapfb \
           xf86-input-keyboard"

EXTRA_IMAGEDEPENDS += "u-boot"
EXTRA_IMAGEDEPENDS += "kalimba"
#EXTRA_IMAGEDEPENDS += "binandroid"
#EXTRA_IMAGEDEPENDS += "recoveryimage"

#To enable hardware float for atlas7
DEFAULTTUNE = "cortexa7hf"
include conf/machine/include/tune-cortexa7.inc

IMAGE_FSTYPES += "tar.bz2 ext3"

#SERIAL_CONSOLE = "115200 ttyO2"
SERIAL_CONSOLES = "115200;ttySiRF1"

OLDEST_KERNEL = "3.4"
MACHINE_EXTRA_RRECOMMENDS = " kernel-modules"

PREFERRED_PROVIDER_virtual/kernel = "linux-kernel"
PREFERRED_VERSION_kernel = "3.18%"
KERNEL_IMAGETYPE = "zImage"


PREFERRED_VERSION_libusb1 = "1.0.19"

KERNEL_DEVICETREE = "atlas7-evb.dtb atlas7-amber.dtb atlas7-pxp.dtb atlas7-a7ca-amber.dtb atlas7-ds03.dtb atlas7-ds03-recovery.dtb"

#Select dtb for amber or bt
#USE_AMBER = "y"
#USE_A7CA_BT = "y"

#For atlas7 b0 chip,please enable this line:
ATLAS7_B0 = "yes"

#For atla7 entry,please enable this line:
#ATLAS7_ENTRY = "yes"

PREFERRED_PROVIDER_u-boot = "u-boot"
PREFERRED_PROVIDER_virtual/bootloader = "u-boot"

#SPL_BINARY = "MLO"
UBOOT_SUFFIX = "csr"
UBOOT_MACHINE = "atlas7cb_config"

IMAGE_FEATURES += "read-only-rootfs"
MACHINE_FEATURES = "usbgadget usbhost vfat alsa screen wifi touchscreen bluetooth"
DISTRO_FEATURES_DEFAULT = "alsa argp bluetooth ext2 irda largefile pcmcia usbgadget usbhost xattr nfs pci 3g"
DISTRO_FEATURES_append = " systemd"
VIRTUAL-RUNTIME_init_manager = "systemd"
DISTRO_FEATURES_append = " directfb"

#DISTRO_FEATURES_BACKFILL_CONSIDERED = "pulseaudio"
#PACKAGE_EXCLUDE = "curl curl-dev libcurl-dev libcurl"
#PACKAGE_EXCLUDE += "libc6-dev libglib-2.0-dev"
#PACKAGE_EXCLUDE += "qtbase-dev qtdeclarative-dev qtmultimedia-dev qtxmlpatterns-dev"
#PACKAGE_EXCLUDE += "gstreamer1.0-dev gstreamer1.0-plugins-bad-dev gstreamer1.0-plugins-base-dev"
#PACKAGE_EXCLUDE += "libwrap-dev libarchive-dev libatomics-ops-dev libbz2-dev db-dev ncurses-dev gconf-dev"
#PACKAGE_EXCLUDE += "alsa-lib-dev bluez4-dev libcheck-dev cryptodev-linux-dev dbus-dev"
#PACKAGE_EXCLUDE += "libdbus-glib-1-dev libexpat-dev flac-dev flex-dev libgdbm-dev json-c-dev liboil-dev"
#PACKAGE_EXCLUDE += "libltdl-dev liblzma-dev libogg-dev openssl-dev libreadline-dev sbc-dev libsamplerate0-dev"
#PACKAGE_EXCLUDE += "libsndfile-dev speex-dev libsqlite3-dev  python-dbus-dev ofono-dev wayland-dev"

LICENSE_FLAGS_WHITELIST += "commercial_mpg123"

#OVERRIDES .= ":atlas7-product-mode"
#OVERRIDES .= ":atlas7-demo"
#OVERRIDES .= ":atlas7-stress-test"
#OVERRIDES .= ":atlas7-enable-uart0-a"
#OVERRIDES .= ":atlas7-enable-uart0-b"

EXTRA_IMAGE_FEATURES = "debug-tweaks"
EXTRA_IMAGE_FEATURES_atlas7-product-mode = ""

IMAGE_INSTALL_append_atlas7-demo = " icu carplay androidauto race"
IMAGE_INSTALL_append_atlas7-demo = " hibernationapp"

CSR_REPO_SITE ?= "opensource.csr.com"
#We can use manifest and repo sync to fetch the code to poky/sources/,
#These variables tell yocto to fetch code from these local directory
CSR_SOURCE_REPO = "${TOPDIR}/../sources"
SRC_URI_synergy-path = "${CSR_SOURCE_REPO}"
SRC_URI_synergy = "file://synergy"

SRC_URI_csrpm-path = "${CSR_SOURCE_REPO}"
SRC_URI_csrpm = "file://csrpm"

SRC_URI_nanddisk-path = "${CSR_SOURCE_REPO}"
SRC_URI_nanddisk = "file://nanddisk"

SRC_URI_freertos-path = "${CSR_SOURCE_REPO}"
SRC_URI_freertos = "file://freertos"

SRC_URI_u-boot-path = "${CSR_SOURCE_REPO}"
SRC_URI_u-boot = "file://u-boot"

SRC_URI_app-path = "${CSR_SOURCE_REPO}/prebuilts/linux-arm/atlas7"
SRC_URI_app = "file://sgx-demo"

SRC_URI_sgx-linux-km-path = "${CSR_SOURCE_REPO}"
SRC_URI_sgx-linux-km = "file://sgx-linux-km"

SRC_URI_sgx-linux-um-path = "${CSR_SOURCE_REPO}"
SRC_URI_sgx-linux-um = "file://sgx-linux-um"

SRC_URI_csrlauncher-path = "${CSR_SOURCE_REPO}"
SRC_URI_csrlauncher = "file://csrlauncher"

SRC_URI_kernel-path = "${CSR_SOURCE_REPO}"
SRC_URI_kernel = "file://kernel"

#SRC_URI_dwc-eth-qos-path = "${CSR_SOURCE_REPO}"
#SRC_URI_dwc-eth-qos = "file://dwc-eth-qos"

SRC_URI_snps-eth-path = "${CSR_SOURCE_REPO}"
SRC_URI_snps-eth = "file://snps-eth"

SRC_URI_binandroid-path = "${CSR_SOURCE_REPO}"
SRC_URI_binandroid = "file://binandroid"

#SRC_URI_teelib-path = "${CSR_SOURCE_REPO}"
#SRC_URI_teelib = "file://teelib"

SRC_URI_ds-cc-pub-path = "${CSR_SOURCE_REPO}"
SRC_URI_ds-cc-pub = "file://ds-cc-pub"

SRC_URI_csrvisor-path = "${CSR_SOURCE_REPO}"
SRC_URI_csrvisor = "file://csrvisor"

SRC_URI_licensemgr-path = "${CSR_SOURCE_REPO}"
SRC_URI_licensemgr = "file://licensemgr"

SRC_URI_kalimba-path = "${CSR_SOURCE_REPO}"
SRC_URI_kalimba = "file://prebuilts/firmware/atlas7"

SRC_URI_gnss-path = "${CSR_SOURCE_REPO}"
SRC_URI_gnss = "file://prebuilts/linux-arm/atlas7"

SRC_URI_tunex-path = "${CSR_SOURCE_REPO}"
SRC_URI_tunex = "file://prebuilts/linux-arm/atlas7"

SRC_URI_devkit-path = "${CSR_SOURCE_REPO}"
SRC_URI_devkit = "file://prebuilts/linux-arm/atlas7"

SRC_URI_misc-tools-path = "${CSR_SOURCE_REPO}"
SRC_URI_misc-tools = "file://prebuilts/linux-arm/atlas7"

SRC_URI_gstreamer1.0-path = "${CSR_SOURCE_REPO}"
SRC_URI_gstreamer1.0 = "file://gst/gstreamer"

SRC_URI_gstreamer1.0-plugins-base-path = "${CSR_SOURCE_REPO}"
SRC_URI_gstreamer1.0-plugins-base = "file://gst/gst-plugins-base"

SRC_URI_gstreamer1.0-plugins-good-path = "${CSR_SOURCE_REPO}"
SRC_URI_gstreamer1.0-plugins-good = "file://gst/gst-plugins-good"

SRC_URI_gstreamer1.0-plugins-bad-path = "${CSR_SOURCE_REPO}"
SRC_URI_gstreamer1.0-plugins-bad = "file://gst/gst-plugins-bad"

SRC_URI_gstreamer1.0-plugins-ugly-path = "${CSR_SOURCE_REPO}"
SRC_URI_gstreamer1.0-plugins-ugly = "file://gst/gst-plugins-ugly"

SRC_URI_gstreamer1.0-libav-path = "${CSR_SOURCE_REPO}"
SRC_URI_gstreamer1.0-libav = "file://gst/gst-libav"

SRC_URI_gstreamer1.0-plugins-audecoder-path = "${CSR_SOURCE_REPO}"
SRC_URI_gstreamer1.0-plugins-audecoder = "file://prebuilts/linux-arm/atlas7"

SRC_URI_gstreamer1.0-plugins-filebufsrc-path = "${CSR_SOURCE_REPO}"
SRC_URI_gstreamer1.0-plugins-filebufsrc = "file://prebuilts/linux-arm/atlas7"

SRC_URI_AudioCodec-path = "${CSR_SOURCE_REPO}"
SRC_URI_AudioCodec = "file://prebuilts/linux-arm/atlas7"

SRC_URI_libav-path = "${CSR_SOURCE_REPO}"
SRC_URI_libav = "file://gst/libav"

SRC_URI_gst-omx1.2-path = "${CSR_SOURCE_REPO}"
SRC_URI_gst-omx1.2 = "file://gst/gst-omx"

SRC_URI_vdec2-um-path = "${CSR_SOURCE_REPO}"
SRC_URI_vdec2-um = "file://prebuilts/linux-arm/atlas7"

SRC_URI_vdec2-km-path = "${CSR_SOURCE_REPO}"
SRC_URI_vdec2-km = "file://gst/vdec2_km"

SRC_URI_csrplayer-path = "${CSR_SOURCE_REPO}"
SRC_URI_csrplayer = "file://gst/csrplayer"

SRC_URI_MediaInfo-path = "${CSR_SOURCE_REPO}"
SRC_URI_MediaInfo = "file://gst/MediaInfo"

SRC_URI_mmutils-path = "${CSR_SOURCE_REPO}"
SRC_URI_mmutils = "file://gst/utils"

SRC_URI_mp3aacconvert-path = "${CSR_SOURCE_REPO}"
SRC_URI_mp3aacconvert = "file://prebuilts/linux-arm/atlas7"

SRC_URI_equalizer-path = "${CSR_SOURCE_REPO}"
SRC_URI_equalizer = "file://equalizer"

SRC_URI_logo-path = "${CSR_SOURCE_REPO}"
SRC_URI_logo = "file://svauto-framework/logo"

SRC_URI_radio-path = "${CSR_SOURCE_REPO}"
SRC_URI_radio = "file://radio"

SRC_URI_svapi-path = "${CSR_SOURCE_REPO}"
SRC_URI_svapi = "file://svauto-framework/svapi"

SRC_URI_tuxera-file-systems-path = "${CSR_SOURCE_REPO}"
SRC_URI_tuxera-file-systems = "file://svauto-framework/tuxera-file-systems"

SRC_URI_testing-path = "${CSR_SOURCE_REPO}"
SRC_URI_testing = "file://svauto-framework/testing"

SRC_URI_rvcos-path = "${CSR_SOURCE_REPO}"
SRC_URI_rvcos = "file://svauto-framework/rvcos"

SRC_URI_radar-path = "${CSR_SOURCE_REPO}"
SRC_URI_radar = "file://svauto-framework/radar"

SRC_URI_carplay-path = "${CSR_SOURCE_REPO}"
SRC_URI_carplay = "file://prebuilts/linux-arm/atlas7"

SRC_URI_androidauto-path = "${CSR_SOURCE_REPO}"
SRC_URI_androidauto = "file://prebuilts/linux-arm/atlas7"

SRC_URI_race-path = "${CSR_SOURCE_REPO}"
SRC_URI_race = "file://prebuilts/linux-arm/atlas7"

SRC_URI_init-process-path = "${CSR_SOURCE_REPO}"
SRC_URI_init-process = "file://svauto-framework/init-process"
```

## sv-ds03-system/meta-csr-bsp/conf/machine/include/atlas7.inc
```bitbake
BOARD = "atlas7cb"

#$(BR2_SDRAM_TYPE)_${BR2_SDRAM_SIZE}MB${BR2_SDRAM_CLOCK}_${BR2_BOARD}.h
# DDR2_1CS_128MB is not set
# DDR2_1CS_256MB is not set

# DDR2_1CS_1GB is not set
# DDR2_2CS_512MB is not set

# DDR3_1CS_256MB is not set
DDR3_1CS_512MB="y"
# DDR3_2CS_512MB is not set
# DDR3_1CS_1GB is not set
# LPDDR2_2CS_512MB is not set
SDRAM_SIZE="1024"
SDRAM_TYPE="DDR3_1CS"
SDRAM_CLOCK="401"

# ENABLE_BPP32 is not set

# GPSRF_TRIG is not set
GPSRF_TRIGLITE="y"
# GPSRF_3IPLUS_16M is not set
# GPSRF_3IPLUS_26M is not set
# GPSRF_CD4150 is not set

# GPSVER_B116 is not set
GPSVER_S117="y"
# GPSVER_S118 is not set

GPSRF="triglite"
GPSVER="s117"
```

## sv-ds03-system/meta-sv/conf/layer.conf
```bitbake
BBPATH .= ":${LAYERDIR}"
BBFILES += "${LAYERDIR}/recipes-*/*/*.bb \
            ${LAYERDIR}/recipes-*/*/*.bbappend \
            "
BBFILE_COLLECTIONS += "sv"
BBFILE_PATTERN_sv = "^${LAYERDIR}/"
BBFILE_PRIORITY_sv = "30"
```
